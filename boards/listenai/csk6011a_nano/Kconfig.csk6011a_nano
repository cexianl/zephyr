## boards/listenai/csk6011a_nano/Kconfig.csk6011a_nano
```kconfig
# Copyright (c) 2023 by ListenAI Inc.
# SPDX-License-Identifier: Apache-2.0

config BOARD_CSK6011A_NANO
	select SOC_CSK6011A
```

## drivers/audio/Kconfig.cs43l22
```kconfig
# Copyright (c) 2019 Intel Corporation
# SPDX-License-Identifier: Apache-2.0

config AUDIO_CS43L22
	bool "CS43L22 DAC support"
	default n
	select I2C
	select I2S
	depends on GPIO
	help
	  Enable CS43L22 support on the selected board
```

## dts/bindings/audio/cirrus,cs43l22.yaml
```yaml
# Copyright (c) 2018, Intel Corporation
# SPDX-License-Identifier: Apache-2.0

description: CIRRUS LOGIC CS43L22 Audio DAC

compatible: "cirrus,cs43l22"

include: i2c-device.yaml

properties:
    reset-gpios:
      type: phandle-array
      required: true
```

## soc/listenai/csk/csk6x/Kconfig.defconfig.series
```kconfig
# Copyright (c) 2024 Fujie Li <cexianl@gmail.com>
# SPDX-License-Identifier: Apache-2.0

if SOC_SERIES_CSK6X

rsource "Kconfig.defconfig.csk6*"

endif # SOC_SERIES_CSK6X
```

## soc/listenai/csk/csk6x/Kconfig.soc
```kconfig
# Copyright (c) 2024 Fujie Li <cexianl@gmail.com>
# SPDX-License-Identifier: Apache-2.0

config SOC_SERIES_CSK6X
	bool
	select SOC_FAMILY_LISTENAI_CSK6
	help
	  Enable support for ListenAI CSK6X MCU series

config SOC_SERIES
	default "csk6x" if SOC_SERIES_CSK6X

config SOC_CSK6011A
	bool
	select SOC_SERIES_CSK6X

config SOC
	default "csk6011a" if SOC_CSK6011A
```
